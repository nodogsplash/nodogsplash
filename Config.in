## Config.in
```kconfig
config BR2_PACKAGE_NODOGSPLASH
	tristate "nodogsplash - simple configurable hotspot controller"
	default m if CONFIG_DEVEL
	select BR2_PACKAGE_IPTABLES
	select BR2_PACKAGE_IPTABLES_MOD_IMQ
	select BR2_PACKAGE_IPTABLES_MOD_EXTRA
	select BR2_PACKAGE_IPTABLES_MOD_CONNTRACK
	select BR2_PACKAGE_IPTABLES_MOD_IPOPT
	select BR2_PACKAGE_LIBPTHREAD
	select BR2_PACKAGE_TC
	select BR2_PACKAGE_IP
	help
	  Nodogsplash is a simple configurable hotspot controller.
	  It is based on the Wifidog gateway client,
	  but does not require an authentication server.
	  .
	  http://kokoro.ucsd.edu/nodogsplash
	  
```
